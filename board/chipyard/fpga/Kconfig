## board/chipyard/fpga/Kconfig
```kconfig
if TARGET_CHIPYARD

config SYS_BOARD
	default "fpga"

config SYS_VENDOR
	default "chipyard"

config SYS_CPU
	default "generic"

config SYS_CONFIG_NAME
	default "chipyard-fpga"

config SYS_TEXT_BASE
	default 0x80200000 if SPL
	default 0x80000000 if !RISCV_SMODE
	default 0x80200000 if RISCV_SMODE && ARCH_RV64I
	default 0x80400000 if RISCV_SMODE && ARCH_RV32I

config SPL_OPENSBI_LOAD_ADDR
	default 0x80000000

config BOARD_SPECIFIC_OPTIONS # dummy
	def_bool y
	select GENERIC_RISCV
	select SUPPORT_SPL
	select RAM
	select SPL_RAM if SPL
	imply MMC
	imply MMC_SPI
	imply MMC_BROKEN_CD
	imply CMD_MMC
	imply DM_GPIO
	imply CMD_GPIO
	imply SMP
	imply SPL_RAM_SUPPORT
	imply SPL_RAM_DEVICE
	imply CMD_FAT
	imply CMD_FS_GENERIC
	imply DOS_PARTITION
	imply SIFIVE_SERIAL
	imply SYSRESET
	imply SYSRESET_GPIO

endif
```

## configs/chipyard-riscv64_defconfig
```kconfig
CONFIG_RISCV=y
CONFIG_NR_DRAM_BANKS=4
CONFIG_SPL=y
CONFIG_SPL_MMC_SUPPORT=y
CONFIG_DEFAULT_DEVICE_TREE="chipyard.TestHarness.RocketFPGAConfig"
CONFIG_TARGET_CHIPYARD=y
CONFIG_ARCH_RV64I=y
CONFIG_RISCV_SMODE=y
CONFIG_DISTRO_DEFAULTS=y
CONFIG_FIT=y
CONFIG_SPL_TEXT_BASE=0x00010000
CONFIG_SPL_LOAD_FIT_ADDRESS=0x80200000
CONFIG_DISPLAY_CPUINFO=y
CONFIG_DISPLAY_BOARDINFO=y
CONFIG_SPL_CLK=y
CONFIG_SPL_DM_RESET=y
CONFIG_DM_MTD=y
CONFIG_DM_RESET=y
CONFIG_SD_BOOT=y
CONFIG_NET=n
```
